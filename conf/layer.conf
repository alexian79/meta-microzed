## conf/layer.conf
```bitbake
# We have a conf and classes directory, add to BBPATH
BBPATH .= ":${LAYERDIR}"

# We have recipes-* directories, add to BBFILES
BBFILES += "${LAYERDIR}/recipes-*/*/*.bb \
            ${LAYERDIR}/recipes-*/*/*.bbappend"

BBFILE_COLLECTIONS += "meta-microzed"
BBFILE_PATTERN_meta-microzed = "^${LAYERDIR}/"
BBFILE_PRIORITY_meta-microzed = "9"

LAYERDEPENDS_meta-microzed = "xilinx"
LAYERSERIES_COMPAT_meta-microzed = "thud"
```
